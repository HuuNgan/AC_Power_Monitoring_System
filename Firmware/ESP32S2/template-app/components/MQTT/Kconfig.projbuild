## Firmware/ESP32S2/template-app/components/MQTT/Kconfig.projbuild
```kconfig
menu "Topic"
    config VOLTAGE_P_TOPIC
        string "voltage_topic_1"
        default "client/voltage_p"

    config VOLTAGE_N_TOPIC
        string "voltage_topic_2"
        default "client/voltage_n"

    config CURRENT_TOPIC
        string "current_topic"
        default "client/current"
        
    config PHASE_TOPIC
        string "phase_topic"
        default "client/phase"

    config CONTROL_TOPIC
        string "control_topic"
        default "client/control"

    config POWER_TOPIC
        string "power_topic"
        default "client/power"

    config POWER_CONSUMTION_TOPIC
        string "power_consumtion_topic"
        default "client/power_consumtion"
    
endmenu
```

## Firmware/ESP32S2/template-app/components/Wifi/Kconfig.projbuild
```kconfig
menu "SSID"
    config SSID_PIF
        string "PIFLab"
        default "PIFLab"

    config SSPW_PIF
        string "PIFLab_pass"
        default "tamsotam"

    config SSID_CF1
        string "Feel Coffee & Tea Express 1"
        default "Feel Coffee & Tea Express 1"

    config SSPW_CF1
        string "Feel Coffee & Tea Express 1 pass"
        default "giaohangmienphi"

    config SSID_HOME
        string "Home SSID"
        default "DoLLar"

    config SSPW_HOME
        string "Home SSPW"
        default "nowaytohide4520@#"

    config SSID_PIF_COMPANY
        string "PIFlab.io"
        default "PIFlab.io"

    config SSPW_PIF_COMPANY
        string "PIFlab.io pass"
        default "khonghoisaocopass"

endmenu
```
